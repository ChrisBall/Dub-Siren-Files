//1024 values
short LOGPOTLOOKUP[]={
  0, 0, 0, 0, 0, 1, 1, 1, 1, 1, 2, 2, 2, 2, 3, 3, 3, 3, 3, 4, 4, 4, 4, 5, 5, 5, 5, 6, 6, 6, 6, 6, 
  7, 7, 7, 7, 8, 8, 8, 8, 9, 9, 9, 9, 10, 10, 10, 10, 10, 11, 11, 11, 11, 12, 12, 12, 12, 13, 13, 13, 13, 14, 14, 14, 
  14, 15, 15, 15, 15, 16, 16, 16, 16, 17, 17, 17, 18, 18, 18, 18, 19, 19, 19, 19, 20, 20, 20, 20, 21, 21, 21, 21, 22, 22, 22, 23, 
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  940, 942, 945, 948, 950, 953, 955, 958, 961, 963, 966, 968, 971, 974, 976, 979, 982, 984, 987, 990, 992, 995, 998, 1001, 1003, 1006, 1009, 1011, 1014, 1017, 1020, 1022
};

//882 values - 50Hz (at 44.1kHz sample rate)
int SINLOOKUPSIZE=882;
short SINLOOKUP[]={
  2047, 2062, 2076, 2091, 2105, 2120, 2134, 2149, 2164, 2178, 2193, 2207, 2222, 2236, 2251, 2265, 2280, 2294, 2309, 2323, 2338, 2352, 2367, 2381, 2395, 2410, 2424, 2438, 2453, 2467, 2481, 2495, 
  2510, 2524, 2538, 2552, 2566, 2580, 2595, 2609, 2623, 2637, 2651, 2664, 2678, 2692, 2706, 2720, 2734, 2747, 2761, 2775, 2788, 2802, 2815, 2829, 2842, 2856, 2869, 2882, 2896, 2909, 2922, 2935, 
  2948, 2962, 2975, 2988, 3001, 3013, 3026, 3039, 3052, 3064, 3077, 3090, 3102, 3115, 3127, 3139, 3152, 3164, 3176, 3188, 3200, 3212, 3224, 3236, 3248, 3260, 3272, 3283, 3295, 3306, 3318, 3329, 
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  1785, 1800, 1814, 1829, 1843, 1858, 1872, 1887, 1901, 1916, 1930, 1945, 1960, 1974, 1989, 2003, 2018, 2032
};

int SAWLOOKUPSIZE=882;  //both lookups a bit unnecessary, but what the hell.
short SAWLOOKUP[]={ 
  4095, 4090, 4085, 4081, 4076, 4071, 4067, 4062, 4057, 4053, 4048, 4043, 4039, 4034, 4029, 4025, 4020, 4015, 4011, 4006, 4002, 3997, 3992, 3988, 3983, 3978, 3974, 3969, 3964, 3960, 3955, 3950, 
  3946, 3941, 3936, 3932, 3927, 3923, 3918, 3913, 3909, 3904, 3899, 3895, 3890, 3885, 3881, 3876, 3871, 3867, 3862, 3857, 3853, 3848, 3844, 3839, 3834, 3830, 3825, 3820, 3816, 3811, 3806, 3802, 
  3797, 3792, 3788, 3783, 3778, 3774, 3769, 3764, 3760, 3755, 3751, 3746, 3741, 3737, 3732, 3727, 3723, 3718, 3713, 3709, 3704, 3699, 3695, 3690, 3685, 3681, 3676, 3672, 3667, 3662, 3658, 3653, 
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  79, 74, 69, 65, 60, 55, 51, 46, 41, 37, 32, 27, 23, 18, 13, 9, 4, 0
};

#define SAMPLE_RATE 44100.0
#define TICKS_PER_CYCLE (4294967296.0/SAMPLE_RATE)

#define BIAS 2048

#define LEDPIN 53

int POT0=0,POT1=0,POT2=0,POT3=0;
int64_t iter=0; 
int64_t modIter=0; 
int out_DAC0;

const int BUTTONS[]={8,9,11,10,13,12};             //main trigger, drop trigger; mod sine on, mod saw on (else square); main sine on, main saw on (else square)
unsigned int BUTTONSTATES[]={0,0,0,0,0,0};

#define FADEMAX 512    //512 samples attack and release (sustain always 1)
unsigned int FADE=0;    //used in ASR

#define MAXDELAYBUFFERSIZE 44100  //1 second of delay
short DELAYBUFFER[MAXDELAYBUFFERSIZE];
unsigned int delayWriteIndex=0; 
unsigned int pDelayWriteIndex=0;

//---------------------------------------------------------------------------------------------------------------------------------------------------------------

void setup()
{
  Serial.begin(9600);
  /* turn on the timer clock in the power management controller */
  pmc_set_writeprotect(false);
  pmc_enable_periph_clk(ID_TC4);
  /* we want wavesel 01 with RC */
  TC_Configure(/* clock */TC1,/* channel */1, TC_CMR_WAVE | TC_CMR_WAVSEL_UP_RC | TC_CMR_TCCLKS_TIMER_CLOCK2);
  TC_SetRC(TC1, 1, 238); // sets <> 44.1 Khz interrupt rate
  TC_Start(TC1, 1);
  TC1->TC_CHANNEL[1].TC_IER=TC_IER_CPCS;
  TC1->TC_CHANNEL[1].TC_IDR=~TC_IER_CPCS;
  NVIC_EnableIRQ(TC4_IRQn);
  
  analogWrite(DAC0,0);
 
  pinMode(LEDPIN,OUTPUT);
  
  for(int i=0;i<6;i++){
    pinMode(BUTTONS[i],INPUT_PULLUP);  //begin button pins
  }
  
  for(int i=0;i<MAXDELAYBUFFERSIZE;i++){
    DELAYBUFFER[i]=BIAS; //initialise delay buffer to 'zero'
  }
}

//---------------------------------------------------------------------------------------------------------------------------------------------------------------

void loop()
{
  
  POT0 = LOGPOTLOOKUP[analogRead(A1)];  //frequency
  POT1 = LOGPOTLOOKUP[analogRead(A3)];  //mod frequency
  POT2 = analogRead(A0);  //delay  
  POT3 = analogRead(A2);  //feedback
  
//  Serial.print(POT0);
//  Serial.print("\t");
//  Serial.print(POT1);
//  Serial.print("\t") ;
//  Serial.print(POT2);
//  Serial.print("\t") ;
//  Serial.println(POT3);
  
  Serial.println(delayWriteIndex);
  
  if((delayWriteIndex<(22050<<16))||(POT2==0)){
    digitalWrite(LEDPIN,HIGH);
  }else{
    digitalWrite(LEDPIN,LOW);
  }
  //get button states
  buttonUpdate();
}

//---------------------------------------------------------------------------------------------------------------------------------------------------------------

void TC4_Handler()
{
  // We need to get the status to clear it and allow the interrupt to fire again
  TC_GetStatus(TC1, 1);
  
  //need multiple waveforms (with a trigger and mod sync button),modulation (also multiple waveforms) and delay (tape/glitch style)
  
  //'drop' condition-------------------------------------------------------------------------------
  if(BUTTONSTATES[1]==2){
    modIter=0;
  }
  
  if((BUTTONSTATES[0]==2)||(FADE>0)){
    //modulation --------------------------------------------------------------------------------
    int modval=0;
    modIter+=POT1<<5;                    //mod rate: tweak as necessary
    if(BUTTONSTATES[2]==2){
      modIter%=SINLOOKUPSIZE<<16;    
      modval=getBufInterp(SINLOOKUP,SINLOOKUPSIZE,modIter);   
    }else if(BUTTONSTATES[3]==2){
      modIter%=SAWLOOKUPSIZE<<16;    
      modval=getBufInterp(SAWLOOKUP,SAWLOOKUPSIZE,modIter);  
    }else{
      modIter%=SINLOOKUPSIZE<<16;     
      modval=getBufInterp(SINLOOKUP,SINLOOKUPSIZE,modIter); 
      if(modval<2047){      //square wave
        modval=1;
      }else{
        modval=4094;
      }
    }
    modval=(modval<<5);   //mod amount, currently 1 octave
    
    //main osc--------------------------------------------------------------------------------
    iter+=(POT0<<12)+modval; 
    if(BUTTONSTATES[4]==2){
      iter%=SINLOOKUPSIZE<<16;     
      out_DAC0=getBufInterp(SINLOOKUP,SINLOOKUPSIZE,iter);  
    }else if(BUTTONSTATES[5]==2){
      iter%=SAWLOOKUPSIZE<<16;     
      out_DAC0=getBufInterp(SAWLOOKUP,SAWLOOKUPSIZE,iter);  
    }else{
      iter%=SINLOOKUPSIZE<<16;     
      out_DAC0=getBufInterp(SINLOOKUP,SINLOOKUPSIZE,iter); 
      if(out_DAC0<2047){      //square wave
        out_DAC0=1;
      }else{
        out_DAC0=4094;
      }
    }

    //ASR--------------------------------------------------------------------------------------
    if((FADE<FADEMAX)&&(BUTTONSTATES[0]==2)){
      FADE++;
    }else{
      FADE--;
    }
    out_DAC0=volumeMult4096(out_DAC0,FADE<<7);                                 //output volume set at 100% (FADE<<6 instead of FADE<<7 would be 50%)
    
  }else{
    out_DAC0=BIAS;
  }
  
  //delay,feedback,filtering-----------
  pDelayWriteIndex=delayWriteIndex;                                                             //store the previous index (for filling in the gaps later)
  delayWriteIndex+=POT2<<9;                                                                     //increase the index by the specified amount, to the 'oldest' sample (should be from a nice lookup)
  
  //crappy filtering - take a equal mix of current and last sample (2 tap rectangular moving average filter - good for high frequency clicks but not very noticeable otherwise)
  int oldsample=volumeMix4096(getBufInterp(DELAYBUFFER,MAXDELAYBUFFERSIZE,delayWriteIndex),getBufInterp(DELAYBUFFER,MAXDELAYBUFFERSIZE,pDelayWriteIndex),32768); //read oldest sample
  
  oldsample=volumeMult4096(oldsample,((POT3*3)>>1)<<6);  //multiply feedback amount (to 150%)
  
  out_DAC0=volumeAdd4096(oldsample,out_DAC0);       //add the oldest sample to the output
  
  //DELAYBUFFER[delayWriteIndex>>16]=out_DAC0;                                                           //cop out, but sounds so lovely and crunchy. Instead:
  for(unsigned int i=(pDelayWriteIndex>>16);i<(delayWriteIndex>>16);i++){
    int index=i%MAXDELAYBUFFERSIZE;
    DELAYBUFFER[index]=out_DAC0; //write all samples the same! this loop could get messy in short delays (bigger jumps, longer runs to fill);
  }
    
  delayWriteIndex%=MAXDELAYBUFFERSIZE<<16;                                                      //limit the index so it's always within the array
  
  dacc_write_conversion_data(DACC_INTERFACE, out_DAC0);
}

//---------------------------------------------------------------------------------------------------------------------------------------------------------------

int getBufInterp(short int* ARRAYINPUT, int BUFFSIZE, unsigned int INDEX){
  //INDEX should be float bufferPosition * 2^16
  //linear interpolation - allows you to ask for an array entry between indexes e.g. getValInterp(listOfValues, 1024, 34.7*(2^16)); will return a proportional mix of the values at indexes 34 and 35
  //will loop back at the end of the array, e.g. it's possible to request indexes longer than the input
  int LOWER  = INDEX>>16;
  if((INDEX%65536)==0){
    return (ARRAYINPUT[LOWER%BUFFSIZE]);
  }else{
    return linInterp(ARRAYINPUT[LOWER%BUFFSIZE], ARRAYINPUT[(LOWER+1)%BUFFSIZE], INDEX%65536);
  }
}
//SETBUFINTERP?

//---------------------------------------------------------------------------------------------------------------------------------------------------------------

int linInterp(int IN1, int IN2, int WEIGHT){
  return (IN1*(65536-WEIGHT) + IN2*WEIGHT)>>16;
}

//---------------------------------------------------------------------------------------------------------------------------------------------------------------

int volumeMult4096(int INPUTSAMPLE,int VOLFACTOR){
  //simple linear volume change (clips over 1) 
  //INPUTSAMPLE is between 0 and 4095
  //VOLFACTOR is equal to 2^16F, e.g. a doubling of volume would be 2^16*2 = 131072, assumes bias of 2048
  return constrain((((INPUTSAMPLE-BIAS)*VOLFACTOR)>>16)+BIAS,0,4095);
}
//---------------------------------------------------------------------------------------------------------------------------------------------------------------

int volumeMix4096(int INPUTSAMPLE1,int INPUTSAMPLE2,int MIX){
  //simple volume mixer for two samples, contrains to 4095, variable mix of two samples, MIX should be expressed x*(2^16) where x is between 0 and 1.
  return constrain((INPUTSAMPLE1*(65536-MIX)+INPUTSAMPLE2*MIX)>>16,0,4095);
}
//---------------------------------------------------------------------------------------------------------------------------------------------------------------

int volumeAdd4096(int INPUTSAMPLE1,int INPUTSAMPLE2){   //beware unsigned
  //simple volume adder for two samples, contrains to 4095, assumes bias of 2048
  return constrain(INPUTSAMPLE1+INPUTSAMPLE2-BIAS,0,4095);
}


//---------------------------------------------------------------------------------------------------------------------------------------------------------------

void buttonUpdate(){
  for(int i=0;i<6;i++){
    boolean buttonState=digitalRead(BUTTONS[i]);
    if(BUTTONSTATES[i]==3){
      BUTTONSTATES[i]=2;
    }
    if((buttonState==LOW)&&(BUTTONSTATES[i]==0)){
      BUTTONSTATES[i]=3;
    }
    if(BUTTONSTATES[i]==1){
      BUTTONSTATES[i]=0;
    }
    if((buttonState==HIGH)&&(BUTTONSTATES[i]==2)){
      BUTTONSTATES[i]=1;
    }
  }
}

